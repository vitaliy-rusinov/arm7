/* 	
 	Настройка таймера.
*/
                  
#include <LPC23xx.H>                       



void delay(void) {
//Сбросить таймер
	T0TC = 0x00000000;
//Запустить таймер
	T0TCR = 0x00000001;
//Ожидаем окончания счета
	while (T0TCR&0x1) {};
}

void Timer0_Init(void){
//Предделитель таймера = 12000
	T0PR = 12000;
//Сбросить счетчик и делитель
	T0TCR = 0x00000002;
//При совпадении останавливаем, сбрасываем таймер
	T0MCR = 0x00000006;
//Регистр совпадения = 1000 (1 Гц)
	T0MR0 = 1000;
}	


int main (void) {

  unsigned int n;

//Конфигурировать функции входов/выходов порта 0 на модуль GPIO  	   
  PINSEL0 	= 0x00000000;
//IODIR0 - Регистр направления ввода вывода (1 - вывод; 0 - ввод)
  IODIR0 = 0x00038000; /* P0.15..17 программируем на вывод, остальные на ввод */
//IOSET0 - Регистр установки порта (1 - установк; 0 - нет изменений)
  IOSET0 = 0x00038000; /* Устанавливаем высокий уровень на выходах (гасим светодиоды)*/

  Timer0_Init(); /* Настроить таймер */	

  for (;;) {          /* Бесконечный цикл */
    for (n = 0x00008000; n <= 0x00020000; n <<= 1) {
//Бегущая единица 
//IOCLR0 - Регистр сброса порта (1 - сброс; 0 - нет изменения)
      IOCLR0 = n;           /* Установить состояние порта */
      delay();              /* Задержка 1 секунда */
      IOSET0 = 0x00038000;  /* Установить порт */
    }
  }
}
